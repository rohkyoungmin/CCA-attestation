## src/vecu_zephyr/boards/arm64/lkvm_realm/Kconfig.board
```kconfig
config BOARD_LKVM_REALM
	bool "lkvm Realm VM (ARM CCA)"
	depends on SOC_QEMU_CORTEX_A53
```

## src/vecu_zephyr/boards/arm64/lkvm_realm/Kconfig.defconfig
```kconfig
if BOARD_LKVM_REALM

config BOARD
	default "lkvm_realm"

config SYS_CLOCK_HW_CYCLES_PER_SEC
	default 62500000

endif # BOARD_LKVM_REALM
```

## src/vecu_zephyr/boards/arm64/lkvm_realm/lkvm_realm_defconfig
```kconfig
# Reuse qemu_cortex_a53 SoC (ARM Cortex-A53, same arch)
CONFIG_SOC_QEMU_CORTEX_A53=y
CONFIG_BOARD_LKVM_REALM=y

CONFIG_SMP=n
CONFIG_SYS_CLOCK_TICKS_PER_SEC=100

# Console
CONFIG_CONSOLE=y
CONFIG_UART_CONSOLE=y
CONFIG_SERIAL=y
CONFIG_UART_NS16550=y
CONFIG_UART_INTERRUPT_DRIVEN=n

# No GIC, no timer - polling only for Realm boot
CONFIG_ARM_ARCH_TIMER=n
CONFIG_SYS_CLOCK_EXISTS=n

# Disable unused drivers
CONFIG_GPIO=n
CONFIG_I2C=n
CONFIG_SPI=n
```

## src/vecu_zephyr/boards/arm64/lkvm_realm_payload/Kconfig.board
```kconfig
config BOARD_LKVM_REALM_PAYLOAD
	bool "lkvm Realm payload VM (ARM CCA)"
	depends on SOC_QEMU_CORTEX_A53
```

## src/vecu_zephyr/boards/arm64/lkvm_realm_payload/Kconfig.defconfig
```kconfig
if BOARD_LKVM_REALM_PAYLOAD

config BOARD
	default "lkvm_realm_payload"

config SYS_CLOCK_HW_CYCLES_PER_SEC
	default 62500000

endif # BOARD_LKVM_REALM_PAYLOAD
```

## src/vecu_zephyr/build/Kconfig/Kconfig.shield
```kconfig
osource "/home/csos/NDSS/SCRUTINIZER/src/vecu_zephyr/boards/shields/*/Kconfig.shield"
```

## src/vecu_zephyr/build/Kconfig/Kconfig.shield.defconfig
```kconfig
osource "/home/csos/NDSS/SCRUTINIZER/src/vecu_zephyr/boards/shields/*/Kconfig.defconfig"
```
