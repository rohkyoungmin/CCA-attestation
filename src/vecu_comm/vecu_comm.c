#define _GNU_SOURCE
/*
 * vecu_comm.c — V-ECU Inter-VM Communication Benchmark
 *
 * Measures communication overhead between simulated V-ECUs:
 *   Phase 0: Baseline plain TCP echo (no TLS)
 *   Phase 1: TLS-only handshake + echo
 *   Phase 2: TLS + per-message attestation token check
 *
 * Architecture simulation (on localhost):
 *   V-ECU1 (Zephyr/Realm)  ←→ PORT 9001 (baseline TCP)
 *   V-ECU2 (AGL/Normal)    ←→ PORT 9002 (TLS)
 *   V-ECU3 (Linux/Normal)  ←→ PORT 9003 (TLS + attest)
 *
 * Metrics:
 *   - TLS handshake time (us)
 *   - Per-message RTT (us)  [RTT/2 = one-way latency]
 *   - CPU overhead via /proc/self/stat (jiffies)
 *   - Throughput (msgs/sec)
 *
 * Build: gcc -O2 -o vecu_comm vecu_comm.c -lssl -lcrypto -lpthread
 */
#include <stdio.h>
#include <stdlib.h>
#include <string.h>
#include <stdint.h>
#include <unistd.h>
#include <errno.h>
#include <time.h>
#include <signal.h>
#include <pthread.h>
#include <sys/socket.h>
#include <sys/wait.h>
#include <netinet/in.h>
#include <netinet/tcp.h>
#include <arpa/inet.h>
#include <openssl/ssl.h>
#include <openssl/err.h>
#include <openssl/x509.h>
#include <openssl/rsa.h>
#include <openssl/pem.h>
#include <openssl/rand.h>

#define ITERATIONS    200
#define MSG_SIZE      64
#define LISTEN_BACKLOG 8

/* Ports per phase */
#define PORT_TCP_BASE  9001
#define PORT_TLS_ONLY  9002
#define PORT_TLS_ATTEST 9003

/* TLS cert/key paths (generated by measure_all.sh) */
#define CERT_FILE "/tmp/vecu_cert.pem"
#define KEY_FILE  "/tmp/vecu_key.pem"

/* ------------------------------------------------------------------ */
/* Timer                                                                 */
/* ------------------------------------------------------------------ */
static inline int64_t now_us(void) {
    struct timespec ts;
    clock_gettime(CLOCK_MONOTONIC_RAW, &ts);
    return (int64_t)ts.tv_sec * 1000000LL + ts.tv_nsec / 1000LL;
}

/* ------------------------------------------------------------------ */
/* CPU usage: read user+sys jiffies from /proc/self/stat                */
/* ------------------------------------------------------------------ */
static long read_cpu_jiffies(void) {
    FILE *f = fopen("/proc/self/stat", "r");
    if (!f) return 0;
    long utime = 0, stime = 0;
    /* fields: pid(1) comm(2) state(3) ... utime(14) stime(15) */
    fscanf(f, "%*d %*s %*c %*d %*d %*d %*d %*d %*u %*u %*u %*u %*u %ld %ld", &utime, &stime);
    fclose(f);
    return utime + stime;
}

/* ------------------------------------------------------------------ */
/* Statistics                                                            */
/* ------------------------------------------------------------------ */
static void print_stats(const char *label, int64_t *t, int n) {
    int64_t sum = 0, minv = t[0], maxv = t[0];
    int64_t s[ITERATIONS];
    memcpy(s, t, n * sizeof(int64_t));
    for (int i = 0; i < n; i++) {
        sum += t[i];
        if (t[i] < minv) minv = t[i];
        if (t[i] > maxv) maxv = t[i];
    }
    /* insertion sort for percentiles */
    for (int i = 1; i < n; i++) {
        int64_t k = s[i]; int j = i - 1;
        while (j >= 0 && s[j] > k) { s[j+1] = s[j]; j--; }
        s[j+1] = k;
    }
    printf("[%s] N=%d\n", label, n);
    printf("  Mean: %lld us  Min: %lld  P50: %lld  P95: %lld  P99: %lld  Max: %lld\n",
           (long long)(sum/n), (long long)minv,
           (long long)s[n/2],
           (long long)s[(int)(n*0.95)],
           (long long)s[(int)(n*0.99)],
           (long long)maxv);
}

/* ------------------------------------------------------------------ */
/* Self-signed certificate generation (in-memory, for TLS phases)       */
/* ------------------------------------------------------------------ */
static int generate_cert_and_key(const char *cert_path, const char *key_path) {
    EVP_PKEY *pkey = NULL;
    X509 *x509 = NULL;
    int ret = 0;

    /* Generate RSA-2048 key */
    EVP_PKEY_CTX *kctx = EVP_PKEY_CTX_new_id(EVP_PKEY_RSA, NULL);
    if (!kctx) goto done;
    EVP_PKEY_keygen_init(kctx);
    EVP_PKEY_CTX_set_rsa_keygen_bits(kctx, 2048);
    EVP_PKEY_keygen(kctx, &pkey);
    EVP_PKEY_CTX_free(kctx);
    if (!pkey) goto done;

    /* Build self-signed X.509 cert */
    x509 = X509_new();
    if (!x509) goto done;
    ASN1_INTEGER_set(X509_get_serialNumber(x509), 1);
    X509_gmtime_adj(X509_get_notBefore(x509), 0);
    X509_gmtime_adj(X509_get_notAfter(x509), 3600); /* 1 hour */
    X509_set_pubkey(x509, pkey);

    X509_NAME *name = X509_get_subject_name(x509);
    X509_NAME_add_entry_by_txt(name, "CN", MBSTRING_ASC, (unsigned char*)"vecu-test", -1, -1, 0);
    X509_set_issuer_name(x509, name);
    X509_sign(x509, pkey, EVP_sha256());

    /* Write to files */
    FILE *kf = fopen(key_path, "wb");
    if (!kf) goto done;
    PEM_write_PrivateKey(kf, pkey, NULL, NULL, 0, NULL, NULL);
    fclose(kf);

    FILE *cf = fopen(cert_path, "wb");
    if (!cf) goto done;
    PEM_write_X509(cf, x509);
    fclose(cf);
    ret = 1;

done:
    if (x509) X509_free(x509);
    if (pkey) EVP_PKEY_free(pkey);
    return ret;
}

/* ------------------------------------------------------------------ */
/* Phase 0: Plain TCP echo server (child process)                       */
/* ------------------------------------------------------------------ */
static void tcp_echo_server(int port) {
    freopen("/dev/null", "w", stdout);
    freopen("/dev/null", "w", stderr);
    int srv = socket(AF_INET, SOCK_STREAM, 0);
    int opt = 1;
    setsockopt(srv, SOL_SOCKET, SO_REUSEADDR, &opt, sizeof(opt));
    struct sockaddr_in addr = {
        .sin_family = AF_INET,
        .sin_port   = htons(port),
        .sin_addr.s_addr = INADDR_ANY
    };
    bind(srv, (struct sockaddr*)&addr, sizeof(addr));
    listen(srv, LISTEN_BACKLOG);

    int cli = accept(srv, NULL, NULL);
    if (cli < 0) { close(srv); return; }

    char buf[MSG_SIZE];
    ssize_t n;
    while ((n = recv(cli, buf, sizeof(buf), 0)) > 0) {
        send(cli, buf, n, 0);
    }
    close(cli);
    close(srv);
    exit(0);
}

/* ------------------------------------------------------------------ */
/* Phase 1/2: TLS echo server (child process)                           */
/* ------------------------------------------------------------------ */
static void tls_echo_server(int port) {
    freopen("/dev/null", "w", stdout);
    freopen("/dev/null", "w", stderr);
    SSL_CTX *ctx = SSL_CTX_new(TLS_server_method());
    if (!ctx) exit(1);
    SSL_CTX_set_min_proto_version(ctx, TLS1_3_VERSION);
    if (SSL_CTX_use_certificate_file(ctx, CERT_FILE, SSL_FILETYPE_PEM) != 1 ||
        SSL_CTX_use_PrivateKey_file(ctx, KEY_FILE, SSL_FILETYPE_PEM) != 1) {
        SSL_CTX_free(ctx);
        exit(1);
    }

    int srv = socket(AF_INET, SOCK_STREAM, 0);
    int opt = 1;
    setsockopt(srv, SOL_SOCKET, SO_REUSEADDR, &opt, sizeof(opt));
    struct sockaddr_in addr = {
        .sin_family = AF_INET,
        .sin_port   = htons(port),
        .sin_addr.s_addr = INADDR_ANY
    };
    bind(srv, (struct sockaddr*)&addr, sizeof(addr));
    listen(srv, LISTEN_BACKLOG);

    int cli = accept(srv, NULL, NULL);
    if (cli < 0) { SSL_CTX_free(ctx); close(srv); exit(1); }

    SSL *ssl = SSL_new(ctx);
    SSL_set_fd(ssl, cli);
    if (SSL_accept(ssl) != 1) {
        SSL_free(ssl); close(cli); SSL_CTX_free(ctx); close(srv); exit(1);
    }

    char buf[MSG_SIZE];
    int n;
    while ((n = SSL_read(ssl, buf, sizeof(buf))) > 0) {
        SSL_write(ssl, buf, n);
    }
    SSL_shutdown(ssl);
    SSL_free(ssl);
    close(cli);
    SSL_CTX_free(ctx);
    close(srv);
    exit(0);
}

/* ------------------------------------------------------------------ */
/* Wait for server port to be ready                                     */
/* ------------------------------------------------------------------ */
/* Wait for port to appear in LISTEN state via /proc/net/tcp            */
/* (avoids spurious connection that would steal the server's accept)    */
static void wait_for_port(int port, int max_ms) {
    for (int i = 0; i < max_ms; i++) {
        FILE *f = fopen("/proc/net/tcp", "r");
        if (f) {
            char line[256];
            fgets(line, sizeof(line), f); /* skip header */
            while (fgets(line, sizeof(line), f)) {
                unsigned int lport = 0;
                int state = 0;
                /* local_address field: XXXXXXXX:PPPP state ... */
                if (sscanf(line + 6, "%*8X:%4X %*s %2X", &lport, &state) == 2) {
                    if ((int)lport == port && state == 0x0A) { /* 0x0A = TCP_LISTEN */
                        fclose(f);
                        return;
                    }
                }
            }
            fclose(f);
        }
        usleep(1000);
    }
}

/* ------------------------------------------------------------------ */
/* Phase 0: TCP Baseline Measurement                                    */
/* ------------------------------------------------------------------ */
static void run_phase0_tcp(void) {
    printf("\n=== PHASE 0: Baseline TCP Echo (V-ECU1 ←→ V-ECU2, plain TCP) ===\n");
    printf("  Simulates: Zephyr Realm ↔ AGL Normal via virtio-vsock (no encryption)\n");
    printf("  Port: 127.0.0.1:%d  Msg: %d bytes  Iterations: %d\n\n",
           PORT_TCP_BASE, MSG_SIZE, ITERATIONS);

    pid_t pid = fork();
    if (pid == 0) { tcp_echo_server(PORT_TCP_BASE); }

    wait_for_port(PORT_TCP_BASE, 2000);

    int fd = socket(AF_INET, SOCK_STREAM, 0);
    struct sockaddr_in addr = {
        .sin_family = AF_INET,
        .sin_port   = htons(PORT_TCP_BASE),
        .sin_addr.s_addr = inet_addr("127.0.0.1")
    };
    connect(fd, (struct sockaddr*)&addr, sizeof(addr));

    char msg[MSG_SIZE], reply[MSG_SIZE];
    RAND_bytes((unsigned char*)msg, MSG_SIZE);

    int64_t t_rtt[ITERATIONS];
    long cpu_before = read_cpu_jiffies();
    int64_t wall_start = now_us();

    for (int i = 0; i < ITERATIONS; i++) {
        int64_t t0 = now_us();
        send(fd, msg, MSG_SIZE, 0);
        recv(fd, reply, MSG_SIZE, MSG_WAITALL);
        t_rtt[i] = now_us() - t0;
    }

    int64_t wall_elapsed = now_us() - wall_start;
    long cpu_after = read_cpu_jiffies();

    close(fd);
    wait(NULL);

    print_stats("TCP_RTT", t_rtt, ITERATIONS);
    printf("  One-way latency (RTT/2): P50 = %lld us\n", (long long)t_rtt[ITERATIONS/2] / 2);
    printf("  Throughput: %.1f msgs/sec\n", ITERATIONS * 1e6 / wall_elapsed);
    printf("  CPU jiffies consumed: %ld  (user+sys combined)\n", cpu_after - cpu_before);
}

/* ------------------------------------------------------------------ */
/* Phase 1: TLS Handshake + Echo Measurement                            */
/* ------------------------------------------------------------------ */
static void run_phase1_tls(void) {
    printf("\n=== PHASE 1: TLS-Only (V-ECU1 ←→ V-ECU2, TLS 1.3 mTLS simulation) ===\n");
    printf("  Simulates: Zephyr Realm ↔ AGL Normal with TLS channel encryption\n");
    printf("  Port: 127.0.0.1:%d  Msg: %d bytes  Iterations: %d\n\n",
           PORT_TLS_ONLY, MSG_SIZE, ITERATIONS);

    /* Measure TLS handshake separately: one fresh connection per iteration */
    int64_t t_hs[ITERATIONS], t_rtt[ITERATIONS];

    /* For handshake: need ITERATIONS server accept cycles → use single-connection RTT for throughput */
    /* Handshake: fork server for each iteration */
    SSL_CTX *cctx = SSL_CTX_new(TLS_client_method());
    SSL_CTX_set_min_proto_version(cctx, TLS1_3_VERSION);
    SSL_CTX_set_verify(cctx, SSL_VERIFY_NONE, NULL);

    printf("  [Handshake measurement: %d fresh TLS connections]\n", ITERATIONS);

    for (int i = 0; i < ITERATIONS; i++) {
        /* Fork a one-shot TLS server for each handshake measurement */
        pid_t pid = fork();
        if (pid == 0) { tls_echo_server(PORT_TLS_ONLY); }
        wait_for_port(PORT_TLS_ONLY, 1000);

        int fd = socket(AF_INET, SOCK_STREAM, 0);
        struct sockaddr_in addr = {
            .sin_family = AF_INET,
            .sin_port   = htons(PORT_TLS_ONLY),
            .sin_addr.s_addr = inet_addr("127.0.0.1")
        };
        connect(fd, (struct sockaddr*)&addr, sizeof(addr));

        int64_t t0 = now_us();
        SSL *ssl = SSL_new(cctx);
        SSL_set_fd(ssl, fd);
        SSL_connect(ssl);
        int64_t t_hs_done = now_us();
        t_hs[i] = t_hs_done - t0;

        /* One RTT after handshake */
        char msg[MSG_SIZE], reply[MSG_SIZE];
        RAND_bytes((unsigned char*)msg, MSG_SIZE);
        int64_t tr0 = now_us();
        SSL_write(ssl, msg, MSG_SIZE);
        SSL_read(ssl, reply, MSG_SIZE);
        t_rtt[i] = now_us() - tr0;

        SSL_shutdown(ssl);
        SSL_free(ssl);
        close(fd);
        waitpid(pid, NULL, 0);
    }

    SSL_CTX_free(cctx);

    print_stats("TLS_HANDSHAKE", t_hs, ITERATIONS);
    print_stats("TLS_MSG_RTT",   t_rtt, ITERATIONS);
    printf("  One-way latency (RTT/2): P50 = %lld us\n", (long long)t_rtt[ITERATIONS/2] / 2);

    /* Compute overhead vs baseline (read from Phase 0 - estimated) */
    int64_t hs_mean = 0, rtt_mean = 0;
    for (int i = 0; i < ITERATIONS; i++) { hs_mean += t_hs[i]; rtt_mean += t_rtt[i]; }
    hs_mean /= ITERATIONS; rtt_mean /= ITERATIONS;
    printf("  TLS handshake mean: %lld us\n", (long long)hs_mean);
    printf("  TLS per-msg RTT mean: %lld us\n", (long long)rtt_mean);
}

/* ------------------------------------------------------------------ */
/* Phase 2: TLS + Attestation Token Check per Message                   */
/* ------------------------------------------------------------------ */
static void run_phase2_tls_attest(void) {
    printf("\n=== PHASE 2: TLS + Attestation Token Verification per Session ===\n");
    printf("  Simulates: V-ECU1 sends CCA attestation token → V-ECU2 verifies before accepting\n");
    printf("  Port: 127.0.0.1:%d  Msg: %d bytes  Iterations: %d\n\n",
           PORT_TLS_ATTEST, MSG_SIZE, ITERATIONS);

    /* Check if attestation token exists */
    int has_token = (access("/tmp/cca_token.bin", R_OK) == 0 &&
                     access("/tmp/cca_pubkey.pem", R_OK) == 0);
    if (!has_token) {
        printf("  [!] /tmp/cca_token.bin not found — skipping in-band token overhead\n");
        printf("  [!] Run 'src/vecu_attest/attest_gen' first to generate token\n");
        return;
    }

    /* Load token */
    FILE *tf = fopen("/tmp/cca_token.bin", "rb");
    uint32_t token_total;
    fread(&token_total, 4, 1, tf);
    uint8_t *token_buf = malloc(token_total);
    fread(token_buf, token_total, 1, tf);
    fclose(tf);

    /* Load pubkey for verification */
    FILE *kf = fopen("/tmp/cca_pubkey.pem", "rb");
    EVP_PKEY *pubkey = PEM_read_PUBKEY(kf, NULL, NULL, NULL);
    fclose(kf);

    SSL_CTX *cctx = SSL_CTX_new(TLS_client_method());
    SSL_CTX_set_min_proto_version(cctx, TLS1_3_VERSION);
    SSL_CTX_set_verify(cctx, SSL_VERIFY_NONE, NULL);

    int64_t t_session[ITERATIONS];  /* handshake + token verify + 1 msg RTT */
    int64_t t_token_verify[ITERATIONS];

    size_t claim_len = token_total > 103 ? token_total - 103 : token_total;

    for (int i = 0; i < ITERATIONS; i++) {
        pid_t pid = fork();
        if (pid == 0) { tls_echo_server(PORT_TLS_ATTEST); }
        wait_for_port(PORT_TLS_ATTEST, 1000);

        int fd = socket(AF_INET, SOCK_STREAM, 0);
        struct sockaddr_in addr = {
            .sin_family = AF_INET,
            .sin_port   = htons(PORT_TLS_ATTEST),
            .sin_addr.s_addr = inet_addr("127.0.0.1")
        };
        connect(fd, (struct sockaddr*)&addr, sizeof(addr));

        int64_t t0 = now_us();

        /* TLS handshake */
        SSL *ssl = SSL_new(cctx);
        SSL_set_fd(ssl, fd);
        SSL_connect(ssl);

        /* Attestation token verification (simulates verifier checking token before trusting channel) */
        int64_t tv0 = now_us();
        EVP_MD_CTX *mctx = EVP_MD_CTX_new();
        EVP_DigestVerifyInit(mctx, NULL, EVP_sha384(), NULL, pubkey);
        EVP_DigestVerifyUpdate(mctx, token_buf, claim_len);
        EVP_DigestVerifyFinal(mctx, token_buf + claim_len, token_total - claim_len);
        EVP_MD_CTX_free(mctx);
        int64_t tv1 = now_us();
        t_token_verify[i] = tv1 - tv0;

        /* Echo RTT */
        char msg[MSG_SIZE], reply[MSG_SIZE];
        RAND_bytes((unsigned char*)msg, MSG_SIZE);
        SSL_write(ssl, msg, MSG_SIZE);
        SSL_read(ssl, reply, MSG_SIZE);

        t_session[i] = now_us() - t0;

        SSL_shutdown(ssl);
        SSL_free(ssl);
        close(fd);
        waitpid(pid, NULL, 0);
    }

    SSL_CTX_free(cctx);
    free(token_buf);
    EVP_PKEY_free(pubkey);

    print_stats("TLS_ATTEST_SESSION_TOTAL", t_session,      ITERATIONS);
    print_stats("TLS_ATTEST_TOKEN_VERIFY",  t_token_verify, ITERATIONS);

    int64_t sess_mean = 0, tv_mean = 0;
    for (int i = 0; i < ITERATIONS; i++) { sess_mean += t_session[i]; tv_mean += t_token_verify[i]; }
    sess_mean /= ITERATIONS; tv_mean /= ITERATIONS;
    printf("  Token verify fraction: %.1f%% of total session setup time\n",
           100.0 * tv_mean / sess_mean);
}

/* ------------------------------------------------------------------ */
/* Overhead ratio summary                                               */
/* ------------------------------------------------------------------ */
static void print_overhead_summary(int64_t *tcp_rtt, int64_t *tls_hs,
                                   int64_t *tls_rtt, int64_t *attest_sess,
                                   int64_t *attest_verify) {
    int64_t tcp_mean = 0, hs_mean = 0, tls_rtt_mean = 0,
            sess_mean = 0, verify_mean = 0;
    for (int i = 0; i < ITERATIONS; i++) {
        tcp_mean    += tcp_rtt[i];
        hs_mean     += tls_hs[i];
        tls_rtt_mean+= tls_rtt[i];
        sess_mean   += attest_sess[i];
        verify_mean += attest_verify[i];
    }
    tcp_mean     /= ITERATIONS;
    hs_mean      /= ITERATIONS;
    tls_rtt_mean /= ITERATIONS;
    sess_mean    /= ITERATIONS;
    verify_mean  /= ITERATIONS;

    printf("\n╔══════════════════════════════════════════════════════════════╗\n");
    printf("║         OVERHEAD RATIO SUMMARY (논리적 오버헤드 추이)           ║\n");
    printf("╠══════════════════════════════════════════════════════════════╣\n");
    printf("║ Metric                          │ Mean(us) │ Overhead vs TCP ║\n");
    printf("╠══════════════════════════════════════════════════════════════╣\n");
    printf("║ Baseline TCP RTT                │ %8lld │ 0%% (reference) ║\n", (long long)tcp_mean);
    printf("║ TLS Handshake                   │ %8lld │ +%5.0f%%          ║\n",
           (long long)hs_mean, 100.0*(hs_mean-tcp_mean)/tcp_mean);
    printf("║ TLS per-msg RTT                 │ %8lld │ +%5.0f%%          ║\n",
           (long long)tls_rtt_mean, 100.0*(tls_rtt_mean-tcp_mean)/tcp_mean);
    printf("║ TLS+Attest session total        │ %8lld │ +%5.0f%%          ║\n",
           (long long)sess_mean, 100.0*(sess_mean-tcp_mean)/tcp_mean);
    printf("║ Attestation token verify only   │ %8lld │ +%5.0f%%          ║\n",
           (long long)verify_mean, 100.0*verify_mean/tcp_mean);
    printf("╚══════════════════════════════════════════════════════════════╝\n");
    printf("\nV-ECU Communication Map:\n");
    printf("  [V-ECU1: Zephyr/Realm] ←TCP→  [V-ECU2: AGL/Normal]   (PORT %d)\n", PORT_TCP_BASE);
    printf("  [V-ECU1: Zephyr/Realm] ←TLS→  [V-ECU2: AGL/Normal]   (PORT %d)\n", PORT_TLS_ONLY);
    printf("  [V-ECU1: Zephyr/Realm] ←TLS+Attest→ [V-ECU3: Linux/Normal] (PORT %d)\n", PORT_TLS_ATTEST);
}

/* ------------------------------------------------------------------ */
/* main                                                                  */
/* ------------------------------------------------------------------ */
int main(void) {
    signal(SIGCHLD, SIG_DFL);
    signal(SIGPIPE, SIG_IGN);

    /* Generate TLS cert/key if not present */
    if (access(CERT_FILE, R_OK) != 0 || access(KEY_FILE, R_OK) != 0) {
        printf("[*] Generating self-signed TLS cert for measurement...\n");
        if (!generate_cert_and_key(CERT_FILE, KEY_FILE)) {
            fprintf(stderr, "Failed to generate TLS cert\n");
            return 1;
        }
        printf("[*] TLS cert written to %s\n\n", CERT_FILE);
    }

    printf("=== V-ECU INTER-VM COMMUNICATION BENCHMARK (CLOCK_MONOTONIC_RAW) ===\n");
    printf("  Platform  : Linux (WSL2, simulating ARM CCA V-ECU topology)\n");
    printf("  Transport : localhost TCP / TLS 1.3\n");
    printf("  Iterations: %d per phase\n", ITERATIONS);
    printf("  Msg size  : %d bytes\n", MSG_SIZE);

    /* Storage for cross-phase comparison */
    int64_t tcp_rtt_data[ITERATIONS]    = {0};
    int64_t tls_hs_data[ITERATIONS]     = {0};
    int64_t tls_rtt_data[ITERATIONS]    = {0};
    int64_t attest_sess_data[ITERATIONS]= {0};
    int64_t attest_ver_data[ITERATIONS] = {0};

    /* --- Phase 0: TCP baseline --- */
    {
        printf("\n=== PHASE 0: Baseline TCP Echo (V-ECU1←→V-ECU2, plain TCP) ===\n");
        printf("  Port: 127.0.0.1:%d\n\n", PORT_TCP_BASE);

        pid_t pid = fork();
        if (pid == 0) { tcp_echo_server(PORT_TCP_BASE); }
        wait_for_port(PORT_TCP_BASE, 2000);

        int fd = socket(AF_INET, SOCK_STREAM, 0);
        struct sockaddr_in addr = {
            .sin_family = AF_INET,
            .sin_port   = htons(PORT_TCP_BASE),
            .sin_addr.s_addr = inet_addr("127.0.0.1")
        };
        connect(fd, (struct sockaddr*)&addr, sizeof(addr));

        char msg[MSG_SIZE], reply[MSG_SIZE];
        RAND_bytes((unsigned char*)msg, MSG_SIZE);
        long cpu_before = read_cpu_jiffies();
        int64_t wall_start = now_us();

        for (int i = 0; i < ITERATIONS; i++) {
            int64_t t0 = now_us();
            send(fd, msg, MSG_SIZE, 0);
            recv(fd, reply, MSG_SIZE, MSG_WAITALL);
            tcp_rtt_data[i] = now_us() - t0;
        }

        int64_t wall_elapsed = now_us() - wall_start;
        long cpu_after = read_cpu_jiffies();
        close(fd);
        waitpid(pid, NULL, 0);

        print_stats("TCP_BASELINE_RTT", tcp_rtt_data, ITERATIONS);
        printf("  One-way latency P50: %lld us\n", (long long)tcp_rtt_data[ITERATIONS/2] / 2);
        printf("  Throughput: %.1f msgs/sec\n", ITERATIONS * 1e6 / wall_elapsed);
        printf("  CPU jiffies: %ld\n", cpu_after - cpu_before);
    }

    /* --- Phase 1: TLS handshake + RTT --- */
    {
        printf("\n=== PHASE 1: TLS 1.3 Handshake + Echo (V-ECU1←→V-ECU2, encrypted) ===\n");
        printf("  Port: 127.0.0.1:%d  [%d fresh connections for handshake timing]\n\n",
               PORT_TLS_ONLY, ITERATIONS);

        SSL_CTX *cctx = SSL_CTX_new(TLS_client_method());
        SSL_CTX_set_min_proto_version(cctx, TLS1_3_VERSION);
        SSL_CTX_set_verify(cctx, SSL_VERIFY_NONE, NULL);

        for (int i = 0; i < ITERATIONS; i++) {
            pid_t pid = fork();
            if (pid == 0) { tls_echo_server(PORT_TLS_ONLY); }
            wait_for_port(PORT_TLS_ONLY, 500);

            int fd = socket(AF_INET, SOCK_STREAM, 0);
            struct sockaddr_in addr = {
                .sin_family = AF_INET,
                .sin_port   = htons(PORT_TLS_ONLY),
                .sin_addr.s_addr = inet_addr("127.0.0.1")
            };
            connect(fd, (struct sockaddr*)&addr, sizeof(addr));

            int64_t t0 = now_us();
            SSL *ssl = SSL_new(cctx);
            SSL_set_fd(ssl, fd);
            SSL_connect(ssl);
            tls_hs_data[i] = now_us() - t0;

            char msg[MSG_SIZE], reply[MSG_SIZE];
            RAND_bytes((unsigned char*)msg, MSG_SIZE);
            int64_t tr0 = now_us();
            SSL_write(ssl, msg, MSG_SIZE);
            SSL_read(ssl, reply, MSG_SIZE);
            tls_rtt_data[i] = now_us() - tr0;

            SSL_shutdown(ssl);
            SSL_free(ssl);
            close(fd);
            waitpid(pid, NULL, 0);
        }
        SSL_CTX_free(cctx);

        print_stats("TLS_HANDSHAKE",  tls_hs_data,  ITERATIONS);
        print_stats("TLS_MSG_RTT",    tls_rtt_data, ITERATIONS);
    }

    /* --- Phase 2: TLS + attestation token verify --- */
    {
        printf("\n=== PHASE 2: TLS + CCA Attestation (V-ECU1←→V-ECU3, full trust chain) ===\n");
        printf("  Port: 127.0.0.1:%d\n\n", PORT_TLS_ATTEST);

        int has_token = (access("/tmp/cca_token.bin", R_OK) == 0 &&
                         access("/tmp/cca_pubkey.pem", R_OK) == 0);
        if (!has_token) {
            printf("  [!] No attestation token found at /tmp/cca_token.bin\n");
            printf("  [!] Skipping Phase 2 — run attest_gen first\n");
        } else {
            FILE *tf = fopen("/tmp/cca_token.bin", "rb");
            uint32_t token_total;
            fread(&token_total, 4, 1, tf);
            uint8_t *token_buf = malloc(token_total);
            fread(token_buf, token_total, 1, tf);
            fclose(tf);

            FILE *kf = fopen("/tmp/cca_pubkey.pem", "rb");
            EVP_PKEY *pubkey = PEM_read_PUBKEY(kf, NULL, NULL, NULL);
            fclose(kf);

            size_t claim_len = token_total > 103 ? token_total - 103 : token_total;

            SSL_CTX *cctx = SSL_CTX_new(TLS_client_method());
            SSL_CTX_set_min_proto_version(cctx, TLS1_3_VERSION);
            SSL_CTX_set_verify(cctx, SSL_VERIFY_NONE, NULL);

            for (int i = 0; i < ITERATIONS; i++) {
                pid_t pid = fork();
                if (pid == 0) { tls_echo_server(PORT_TLS_ATTEST); }
                wait_for_port(PORT_TLS_ATTEST, 500);

                int fd = socket(AF_INET, SOCK_STREAM, 0);
                struct sockaddr_in addr = {
                    .sin_family = AF_INET,
                    .sin_port   = htons(PORT_TLS_ATTEST),
                    .sin_addr.s_addr = inet_addr("127.0.0.1")
                };
                connect(fd, (struct sockaddr*)&addr, sizeof(addr));

                int64_t t0 = now_us();

                SSL *ssl = SSL_new(cctx);
                SSL_set_fd(ssl, fd);
                SSL_connect(ssl);

                /* Attestation token verify */
                int64_t tv0 = now_us();
                EVP_MD_CTX *mctx = EVP_MD_CTX_new();
                EVP_DigestVerifyInit(mctx, NULL, EVP_sha384(), NULL, pubkey);
                EVP_DigestVerifyUpdate(mctx, token_buf, claim_len);
                EVP_DigestVerifyFinal(mctx, token_buf + claim_len, token_total - claim_len);
                EVP_MD_CTX_free(mctx);
                attest_ver_data[i] = now_us() - tv0;

                char msg[MSG_SIZE], reply[MSG_SIZE];
                RAND_bytes((unsigned char*)msg, MSG_SIZE);
                SSL_write(ssl, msg, MSG_SIZE);
                SSL_read(ssl, reply, MSG_SIZE);

                attest_sess_data[i] = now_us() - t0;

                SSL_shutdown(ssl);
                SSL_free(ssl);
                close(fd);
                waitpid(pid, NULL, 0);
            }
            SSL_CTX_free(cctx);
            free(token_buf);
            EVP_PKEY_free(pubkey);

            print_stats("TLS_ATTEST_SESSION", attest_sess_data, ITERATIONS);
            print_stats("TLS_ATTEST_VERIFY",  attest_ver_data,  ITERATIONS);

            int64_t sess_mean = 0, ver_mean = 0;
            for (int i = 0; i < ITERATIONS; i++) {
                sess_mean += attest_sess_data[i];
                ver_mean  += attest_ver_data[i];
            }
            sess_mean /= ITERATIONS; ver_mean /= ITERATIONS;
            printf("  Attestation verify fraction: %.1f%% of session setup\n",
                   100.0 * ver_mean / sess_mean);
        }
    }

    /* --- Overhead summary --- */
    print_overhead_summary(tcp_rtt_data, tls_hs_data, tls_rtt_data,
                           attest_sess_data, attest_ver_data);

    return 0;
}
