## CMakeLists.txt
```
cmake_minimum_required(VERSION 3.20.0)

find_package(Zephyr REQUIRED HINTS $ENV{ZEPHYR_BASE})

project(vecu_zephyr_minimal)

target_sources(app PRIVATE
    src/main.c
)
```

## prj.conf
```kconfig
# Minimal Realm boot smoke test
CONFIG_PRINTK=y
CONFIG_EARLY_CONSOLE=y
CONFIG_CONSOLE=y
CONFIG_UART_CONSOLE=y
CONFIG_SERIAL=y

CONFIG_MAIN_STACK_SIZE=4096

# Keep the image as small and simple as possible.
CONFIG_NETWORKING=n
CONFIG_NET_IPV4=n
CONFIG_NET_IPV6=n
CONFIG_POSIX_API=n
CONFIG_SMP=n
```

## src/main.c
```c
#include <zephyr/sys/printk.h>

static void spin_delay(void)
{
	for (volatile unsigned long i = 0; i < 200000000UL; i++) {
		__asm__ volatile("" ::: "memory");
	}
}

int main(void)
{
	printk("\n");
	printk("========================================\n");
	printk(" Zephyr Realm Minimal Smoke Test\n");
	printk("========================================\n");
	printk("[MIN] entered main()\n");

	while (1) {
		printk("[MIN] heartbeat\n");
		spin_delay();
	}

	return 0;
}
```
